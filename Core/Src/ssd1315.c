/**
  ******************************************************************************
  * @file    ssd1315.c
  * @brief   SSD1315 / SSD1306 128x64 OLED (I2C) driver
  *          Framebuffer in RAM + page-dirty incremental flush
  ******************************************************************************
  */
#include "ssd1315.h"
#include "main.h"
#include <string.h>

#define OLED_PAGES        (OLED_HEIGHT / 8)
#define OLED_PAGE_BYTES   OLED_WIDTH

static uint8_t fb[OLED_WIDTH * OLED_HEIGHT / 8];
static uint8_t page_dirty[OLED_PAGES];

/* 5x7 ASCII font (0x20 - 0x7E), 5 bytes per char */
static const uint8_t font5x7[95][5] = {
  {0x00,0x00,0x00,0x00,0x00}, /* 0x20 space */
  {0x00,0x00,0x5F,0x00,0x00}, /* ! */
  {0x00,0x07,0x00,0x07,0x00}, /* " */
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  {0x10,0x08,0x08,0x10,0x08}, /* ~ */
};

static void oled_cmd(uint8_t cmd)
{
  HAL_I2C_Mem_Write(&OLED_I2C, OLED_I2C_ADDR, 0x00, 1, &cmd, 1, 50);
}

static void oled_mark_dirty_all(void)
{
  uint8_t i;
  for (i = 0; i < OLED_PAGES; i++) page_dirty[i] = 1;
}

void oled_init(void)
{
  oled_cmd(0xAE);        /* display off */
  oled_cmd(0xD5); oled_cmd(0x80);   /* clock div */
  oled_cmd(0xA8); oled_cmd(0x3F);   /* multiplex 1/64 */
  oled_cmd(0xD3); oled_cmd(0x00);   /* display offset */
  oled_cmd(0x40);        /* start line 0 */
  oled_cmd(0x8D); oled_cmd(0x14);   /* charge pump on */
  oled_cmd(0x20); oled_cmd(0x00);   /* horizontal addressing */
  oled_cmd(0xA1);        /* segment remap */
  oled_cmd(0xC8);        /* COM scan remapped */
  oled_cmd(0xDA); oled_cmd(0x12);   /* COM pins */
  oled_cmd(0x81); oled_cmd(0xCF);   /* contrast */
  oled_cmd(0xD9); oled_cmd(0xF1);   /* pre-charge */
  oled_cmd(0xDB); oled_cmd(0x40);   /* vcomh */
  oled_cmd(0xA4);        /* resume RAM */
  oled_cmd(0xA6);        /* normal display */
  oled_cmd(0xAF);        /* display on */
  oled_clear();
  oled_show();
}

void oled_clear(void)
{
  memset(fb, 0, sizeof(fb));
  oled_mark_dirty_all();
}

void oled_show(void)
{
  uint8_t page;
  for (page = 0; page < OLED_PAGES; page++)
  {
    if (!page_dirty[page]) continue;
    oled_cmd(0xB0 | page);
    if (HAL_I2C_Mem_Write(&OLED_I2C, OLED_I2C_ADDR, 0x40, 1,
                          &fb[page * OLED_PAGE_BYTES], OLED_PAGE_BYTES, 50) != HAL_OK)
      continue; /* keep dirty, retry next frame (prevents stale ghosting) */
    page_dirty[page] = 0;
  }
}

void oled_set_pixel(int x, int y, uint8_t color)
{
  if (x < 0 || x >= OLED_WIDTH || y < 0 || y >= OLED_HEIGHT) return;
  if (color)
    fb[y / 8 * OLED_WIDTH + x] |= (1 << (y % 8));
  else
    fb[y / 8 * OLED_WIDTH + x] &= ~(1 << (y % 8));
  page_dirty[y / 8] = 1;
}

void oled_fill_rect(int x, int y, int w, int h, uint8_t color)
{
  int i, j;
  for (i = 0; i < w; i++)
    for (j = 0; j < h; j++)
      oled_set_pixel(x + i, y + j, color);
}

void oled_draw_rect(int x, int y, int w, int h, uint8_t color)
{
  int i;
  for (i = 0; i < w; i++)
  {
    oled_set_pixel(x + i, y, color);
    oled_set_pixel(x + i, y + h - 1, color);
  }
  for (i = 0; i < h; i++)
  {
    oled_set_pixel(x, y + i, color);
    oled_set_pixel(x + w - 1, y + i, color);
  }
}

void oled_draw_circle(int cx, int cy, int r, uint8_t color)
{
  int x = -r, y = 0, err = 2 - 2 * r;
  do
  {
    oled_set_pixel(cx - x, cy + y, color);
    oled_set_pixel(cx - y, cy - x, color);
    oled_set_pixel(cx + x, cy - y, color);
    oled_set_pixel(cx + y, cy + x, color);
    r = err;
    if (r <= y) err += ++y * 2 + 1;
    if (r > x || err > y) err += ++x * 2 + 1;
  } while (x < 0);
}

void oled_fill_circle(int cx, int cy, int r, uint8_t color)
{
  int x, y;
  for (y = -r; y <= r; y++)
    for (x = -r; x <= r; x++)
      if (x * x + y * y <= r * r)
        oled_set_pixel(cx + x, cy + y, color);
}

void oled_draw_char(int x, int y, char c, uint8_t color)
{
  int i, j;
  const uint8_t *g;
  if (c < 0x20 || c > 0x7E) c = '?';
  g = font5x7[c - 0x20];
  for (i = 0; i < 5; i++)
    for (j = 0; j < 7; j++)
      if (g[i] & (1 << j))
        oled_set_pixel(x + i, y + j, color);
}

void oled_draw_char_big(int x, int y, char c, uint8_t color)
{
  int i, j, sx, sy;
  const uint8_t *g;
  if (c < 0x20 || c > 0x7E) c = '?';
  g = font5x7[c - 0x20];
  for (i = 0; i < 5; i++)
    for (j = 0; j < 7; j++)
      if (g[i] & (1 << j))
        for (sx = 0; sx < 2; sx++)
          for (sy = 0; sy < 2; sy++)
            oled_set_pixel(x + i * 2 + sx, y + j * 2 + sy, color);
}

void oled_draw_str(int x, int y, const char *s, uint8_t color)
{
  while (*s)
  {
    oled_draw_char(x, y, *s++, color);
    x += 6;
  }
}

void oled_draw_str_big(int x, int y, const char *s, uint8_t color)
{
  while (*s)
  {
    oled_draw_char_big(x, y, *s++, color);
    x += 12;
  }
}

void oled_draw_num(int x, int y, int32_t v, uint8_t color)
{
  char buf[12];
  char *p = buf;
  int32_t n = v;
  if (n == 0)
  {
    *p++ = '0';
    *p = 0;
  }
  else
  {
    if (n < 0) *p++ = '-', n = -n;
    {
      char tmp[11];
      int i = 0;
      while (n > 0 && i < 10) tmp[i++] = '0' + n % 10, n /= 10;
      while (i > 0) *p++ = tmp[--i];
      *p = 0;
    }
  }
  oled_draw_str(x, y, buf, color);
}
